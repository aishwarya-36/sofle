## config/boards/shields/domino/Kconfig.shield
```kconfig
config SHIELD_DOMINO_LEFT
    def_bool $(shields_list_contains,domino_left)

config SHIELD_DOMINO_RIGHT
    def_bool $(shields_list_contains,domino_right)
```
